## clover-trail/conf/machine/clover-trail.conf
```bitbake
# Copyright (C) 2007, Stelios Koroneos - Digital OPSiS, All Rights Reserved
# Released under the MIT license (see packages/COPYING)
#@TYPE: Machine
#@NAME: clover-trail
#@DESCRIPTION: 

require conf/machine/include/tune-i686.inc

# TODO : maybe core2 is more better.
TARGET_ARCH = "i686"
TUNE_ARCH = "i686"

PREFERRED_PROVIDER_virtual/kernel ?= "linux"
PREFERRED_PROVIDER_virtual/xserver ?= "xserver-xorg"

KERNEL_IMAGETYPE = "bzImage"

XSERVER = "xserver-xorg \
           xf86-video-fbdev \
           xf86-video-modesetting \
           "

MACHINE_FEATURES += "x86 pci"
```

## cocon486/conf/layer.conf
```bitbake
# We have a conf and classes directory, append to BBPATH
BBPATH .= ":${LAYERDIR}"

# We have a recipes directory, add to BBFILES
BBFILES += "${LAYERDIR}/recipes*/*/*.bb ${LAYERDIR}/recipes*/*/*.bbappend"

BBFILE_COLLECTIONS += "coconport-cocon486"
BBFILE_PATTERN_coconport-cocon486 := "^${LAYERDIR}/"
BBFILE_PRIORITY_coconport-cocon486 = "7"
LAYERSERIES_COMPAT_coconport-cocon486 = "warrior"
```

## cocon486/conf/machine/cocon486.conf
```bitbake
# Copyright (C) 2007, Stelios Koroneos - Digital OPSiS, All Rights Reserved
# Released under the MIT license (see packages/COPYING)
#@TYPE: Machine
#@NAME: COCON486
#@DESCRIPTION: Machine configuration for a Linux running on x86 compatible machines

require conf/machine/include/tune-x86.inc

TARGET_ARCH = "i486"
TUNE_ARCH = "i486"

PREFERRED_PROVIDER_virtual/kernel = "linux"
PREFERRED_PROVIDER_virtual/xserver = "xserver-xorg"

KERNEL_IMAGETYPE = "bzImage"

MACHINE_EXTRA_RRECOMMENDS = " kernel-modules"
TARGET_VENDOR = "-pc"
MACHINE_FEATURES = "nfs ipv4 ipv6 wifi alsa ext2 vfat pcmcia usbhost pci largefile nls xattr x86 x11 argp opengl udev pcbios"

udevdir = "/dev"

KERNEL_IMAGETYPE = "bzImage"
```

## common/conf/layer.conf
```bitbake
# We have a conf and classes directory, append to BBPATH
BBPATH .= ":${LAYERDIR}"

# We have a recipes directory, add to BBFILES
BBFILES += "${LAYERDIR}/recipes*/*/*.bb ${LAYERDIR}/recipes*/*/*.bbappend"

BBFILE_COLLECTIONS += "coconport"
BBFILE_PATTERN_coconport := "^${LAYERDIR}/"
BBFILE_PRIORITY_coconport = "7"
LAYERSERIES_COMPAT_coconport = "warrior"

# This should only be incremented on significant changes that will
# cause compatibility issues with other layers
LAYERVERSION_coconport = "1"
```

## primo81/conf/layer.conf
```bitbake
# We have a conf and classes directory, append to BBPATH
BBPATH .= ":${LAYERDIR}"

# We have a recipes directory, add to BBFILES
BBFILES += "${LAYERDIR}/recipes*/*/*.bb ${LAYERDIR}/recipes*/*/*.bbappend"

BBFILE_COLLECTIONS += "coconport-primo81"
BBFILE_PATTERN_coconport-primo81 := "^${LAYERDIR}/"
BBFILE_PRIORITY_coconport-primo81 = "7"

# This should only be incremented on significant changes that will
# cause compatibility issues with other layers
LAYERVERSION_coconport-primo81 = "1"
```

## primo81/conf/machine/include/sun6i.inc
```bitbake
require conf/machine/include/sunxi.inc
require conf/machine/include/tune-cortexa7.inc

# meta-sunxi is not having sun6i yet, add on it.
SOC_FAMILY = "sun6i"
```

## primo81/conf/machine/primo81.conf
```bitbake
#@TYPE: Machine
#@NAME: MSI Primo 81
#@DESCRIPTION: Machine configuration for the MSI Primo 81 Tablet with A31s CPU
#http://linux-sunxi.org/MSI_Primo81

require conf/machine/include/sun6i.inc

KERNEL_DEVICETREE = "sun6i-a31s-primo81.dtb"
UBOOT_MACHINE = "MSI_Primo81_config"

# Using mainline kernel
PREFERRED_PROVIDER_virtual/kernel ?= "linux"
PREFERRED_VERSION_linux = "${KERNGIT}"
PREFERRED_VERSION_linux-libc-headers = "${KERNGIT}"

# Primo 81 haven't Mali, so override this.
XSERVER = "xserver-xorg \
           xf86-video-fbdev \
           xf86-input-evdev \
           xf86-input-mouse \
           xf86-input-keyboard"
```
